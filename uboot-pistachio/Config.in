## uboot-pistachio/Config.in
```kconfig
if PACKAGE_uboot-pistachio-pistachio_marduk
	config PACKAGE_UBOOT_SPL
		bool "Install U-Boot SPL binary image"
		depends on !PACKAGE_XLOADER
		help
		  Install the U-Boot SPL binary image to the images
		  directory.
		  SPL is a first stage bootloader loaded into internal
		  memory in charge of enabling and configuring the
		  external memory (DDR), and load the u-boot program
		  into DDR.

	config PACKAGE_UBOOT_SPL_NAME
		string "U-Boot SPL binary image name"
		default "spl/u-boot-spl.bin"
		depends on PACKAGE_UBOOT_SPL
		help
		  This is the name of the SPL binary, generated during
		  u-boot build. For most platform it is spl/u-boot-spl.bin
		  but not always. It is MLO on OMAP for example.

	menuconfig PACKAGE_UBOOT_ENVIMAGE
		bool "Environment image"
		help
		  Generate a valid binary environment image from a text file
		  describing the key=value pairs of the environment.

		  The environment image will be called uboot-env.bin.

	if PACKAGE_UBOOT_ENVIMAGE

		config PACKAGE_UBOOT_ENVIMAGE_SOURCE
			string "Source file for environment"
			help
			  Text file describing the environment.

		config PACKAGE_UBOOT_ENVIMAGE_SIZE
			string "Size of environment"
			help
			  Size of envronment, can be prefixed with 0x for hexadecimal
			  values.

		config PACKAGE_UBOOT_ENVIMAGE_REDUNDANT
			bool "Environment has two copies"
			help
			  Some platforms define in their U-Boot configuration that the
			  U-Boot environment should be duplicated in two locations (for
			  extra safety). Check your U-Boot configuration for the
			  CONFIG_ENV_ADDR_REDUND and CONFIG_ENV_SIZE_REDUND settings to
			  see if this is the case for your platform.

			  If it is the case, then you should enable this option to
			  ensure that the U-Boot environment image generated by
			  Buildroot is compatible with the "redundant environment"
			  mechanism of U-Boot.

	endif # PACKAGE_UBOOT_ENVIMAGE
endif
```
